## config/sdkconfig.defaults
```kconfig
# Rust often needs a bit of extra main task stack size compared to C
CONFIG_ESP_MAIN_TASK_STACK_SIZE=8000

# Extend watchdog timeout for QEMU (crypto operations are slow in emulation)
# Default is 5 seconds, increase to 30 for QEMU compatibility
CONFIG_ESP_TASK_WDT_TIMEOUT_S=30

# Increase pthread stack size for crypto operations (identity generation)
# Default is 3072, but reticulum identity crypto needs more
CONFIG_PTHREAD_TASK_STACK_SIZE_DEFAULT=8192

# Use this to set FreeRTOS kernel tick frequency to 1000 Hz (100 Hz by default).
# This allows to have higher resolution for thread sleep times.
CONFIG_FREERTOS_HZ=1000

# Enable WiFi
CONFIG_ESP_WIFI_ENABLED=y

# Enable Bluetooth with NimBLE stack (required for esp32-nimble crate)
CONFIG_BT_ENABLED=y
CONFIG_BT_BLUEDROID_ENABLED=n
CONFIG_BT_NIMBLE_ENABLED=y
CONFIG_BT_BLE_ENABLED=y

# Increase memory for networking
CONFIG_ESP_SYSTEM_EVENT_TASK_STACK_SIZE=4096

# Disable USB secondary console (not supported in QEMU, not needed for hardware either)
CONFIG_ESP_CONSOLE_SECONDARY_NONE=y

# For production builds with NVS encryption, use: cargo production-flash
```

## sdkconfig.defaults
```kconfig
# Rust often needs a bit of extra main task stack size compared to C
CONFIG_ESP_MAIN_TASK_STACK_SIZE=8000

# Use this to set FreeRTOS kernel tick frequency to 1000 Hz (100 Hz by default).
# This allows to have higher resolution for thread sleep times.
CONFIG_FREERTOS_HZ=1000

# Enable WiFi
CONFIG_ESP_WIFI_ENABLED=y

# Enable Bluetooth
CONFIG_BT_ENABLED=y
CONFIG_BT_BLUEDROID_ENABLED=y
CONFIG_BT_BLE_ENABLED=y

# Increase memory for networking
CONFIG_ESP_SYSTEM_EVENT_TASK_STACK_SIZE=4096
```
